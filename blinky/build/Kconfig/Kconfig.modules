## blinky/build/Kconfig/Kconfig.modules
```kconfig
menu "canopennode (/home/florijan/zephyrproject/modules/lib/canopennode)"
osource "$(ZEPHYR_CANOPENNODE_KCONFIG)"
config ZEPHYR_CANOPENNODE_MODULE
	bool
	default y
endmenu
menu "hal_gigadevice (/home/florijan/zephyrproject/modules/hal/gigadevice)"
osource "$(ZEPHYR_HAL_GIGADEVICE_KCONFIG)"
config ZEPHYR_HAL_GIGADEVICE_MODULE
	bool
	default y
endmenu
menu "hal_nordic (/home/florijan/zephyrproject/modules/hal/nordic)"
osource "$(ZEPHYR_HAL_NORDIC_KCONFIG)"
config ZEPHYR_HAL_NORDIC_MODULE
	bool
	default y
endmenu
menu "hal_nxp (/home/florijan/zephyrproject/modules/hal/nxp)"
osource "$(ZEPHYR_HAL_NXP_KCONFIG)"
config ZEPHYR_HAL_NXP_MODULE
	bool
	default y
endmenu
menu "hal_rpi_pico (/home/florijan/zephyrproject/modules/hal/rpi_pico)"
osource "$(ZEPHYR_HAL_RPI_PICO_KCONFIG)"
config ZEPHYR_HAL_RPI_PICO_MODULE
	bool
	default y
endmenu
menu "liblc3codec (/home/florijan/zephyrproject/modules/lib/liblc3codec)"
osource "$(ZEPHYR_LIBLC3CODEC_KCONFIG)"
config ZEPHYR_LIBLC3CODEC_MODULE
	bool
	default y
endmenu
menu "littlefs (/home/florijan/zephyrproject/modules/fs/littlefs)"
osource "$(ZEPHYR_LITTLEFS_KCONFIG)"
config ZEPHYR_LITTLEFS_MODULE
	bool
	default y
endmenu
menu "loramac-node (/home/florijan/zephyrproject/modules/lib/loramac-node)"
osource "$(ZEPHYR_LORAMAC_NODE_KCONFIG)"
config ZEPHYR_LORAMAC_NODE_MODULE
	bool
	default y
endmenu
menu "lvgl (/home/florijan/zephyrproject/modules/lib/gui/lvgl)"
osource "/home/florijan/zephyrproject/modules/lib/gui/lvgl/zephyr/Kconfig"
config ZEPHYR_LVGL_MODULE
	bool
	default y
endmenu
menu "lz4 (/home/florijan/zephyrproject/modules/lib/lz4)"
osource "$(ZEPHYR_LZ4_KCONFIG)"
config ZEPHYR_LZ4_MODULE
	bool
	default y
endmenu
menu "mbedtls (/home/florijan/zephyrproject/modules/crypto/mbedtls)"
osource "$(ZEPHYR_MBEDTLS_KCONFIG)"
config ZEPHYR_MBEDTLS_MODULE
	bool
	default y
endmenu
menu "nanopb (/home/florijan/zephyrproject/modules/lib/nanopb)"
osource "$(ZEPHYR_NANOPB_KCONFIG)"
config ZEPHYR_NANOPB_MODULE
	bool
	default y
endmenu
menu "sof (/home/florijan/zephyrproject/modules/audio/sof)"
osource "/home/florijan/zephyrproject/modules/audio/sof/zephyr/Kconfig"
config ZEPHYR_SOF_MODULE
	bool
	default y
endmenu
menu "tflite-micro (/home/florijan/zephyrproject/modules/lib/tflite-micro)"
osource "$(ZEPHYR_TFLITE_MICRO_KCONFIG)"
config ZEPHYR_TFLITE_MICRO_MODULE
	bool
	default y
endmenu
menu "TraceRecorder (/home/florijan/zephyrproject/modules/debug/TraceRecorder)"
osource "/home/florijan/zephyrproject/modules/debug/TraceRecorder/kernelports/Zephyr/Kconfig"
config ZEPHYR_TRACERECORDER_MODULE
	bool
	default y
endmenu
menu "trusted-firmware-m (/home/florijan/zephyrproject/modules/tee/tf-m/trusted-firmware-m)"
osource "$(ZEPHYR_TRUSTED_FIRMWARE_M_KCONFIG)"
config ZEPHYR_TRUSTED_FIRMWARE_M_MODULE
	bool
	default y
endmenu
menu "zscilib (/home/florijan/zephyrproject/modules/lib/zscilib)"
osource "/home/florijan/zephyrproject/modules/lib/zscilib/Kconfig.zscilib"
config ZEPHYR_ZSCILIB_MODULE
	bool
	default y
endmenu
```
